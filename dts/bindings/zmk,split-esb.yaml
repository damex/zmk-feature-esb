## dts/bindings/zmk,split-esb.yaml
```yaml
# Copyright 2026 Roman Kuzmitskii (@damex)
# SPDX-License-Identifier: MIT

description: |
  Shared ESB link identity for a single-peripheral ZMK ESB split. The central and
  the peripheral must declare identical values to pair. Place this node in a dtsi
  included by both sides.

compatible: "zmk,split-esb"

properties:
  base-address:
    type: uint8-array
    required: true
    description: 4-byte ESB base address for pipe 0.
  prefix:
    type: int
    required: true
    description: 1-byte address prefix for pipe 0.
  rf-channel:
    type: int
    required: true
    description: RF channel, 2400 + N MHz (0-100).
  tx-power-dbm:
    type: int
    default: 0
    description: Boot TX output power, dBm. Radio rounds to nearest supported level.
  retransmit-count:
    type: int
    default: 3
    description: Hardware retransmit attempts before an unacked packet is dropped.
  retransmit-delay-us:
    type: int
    default: 600
    description: Delay between retransmits, microseconds.
  use-fast-ramp-up:
    type: boolean
    description: |
      Shorter radio TX/RX ramp-up delay. nRF52/nRF53 only; both sides must match.
  crc-bits:
    type: int
    default: 16
    enum: [0, 8, 16]
    description: CRC width in bits (0 disables CRC). Both sides must match.
  lossy-codes:
    type: array
    description: |
      Input axes the peripheral sends without ACK. Each entry is two cells, an
      INPUT_EV_* type and its INPUT_*_<NAME> code, e.g. <INPUT_EV_REL INPUT_REL_X>,
      <INPUT_EV_REL INPUT_REL_Y>. Reserve for high-rate, self-correcting axes
      (pointer motion); non-input split events (key-position, sensor, battery)
      are always ACK'd, and every other input event is ACK'd unless listed.
      Omit for fully lossless link.
```
